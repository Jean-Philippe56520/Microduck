## yocto/meta-kwipi-dev-image/conf/layer.conf
```bitbake
BBPATH .= ":${LAYERDIR}"
BBFILES += "${LAYERDIR}/recipes-*/*/*.bbappend"
BBFILE_COLLECTIONS += "kwipidev"
BBFILE_PATTERN_kwipidev := "^${LAYERDIR}/"
BBFILE_PRIORITY_kwipidev = "23"
LAYERVERSION_kwipidev = "1"
LAYERDEPENDS_kwipidev = "core microduck kwipipy"
LAYERSERIES_COMPAT_kwipidev = "wrynose"
```

## yocto/meta-kwipi-p15-account/conf/layer.conf
```bitbake
BBPATH .= ":${LAYERDIR}"
BBFILES += "${LAYERDIR}/recipes-*/*/*.bbappend"
BBFILE_COLLECTIONS += "kwipiaccount"
BBFILE_PATTERN_kwipiaccount := "^${LAYERDIR}/"
BBFILE_PRIORITY_kwipiaccount = "24"
LAYERVERSION_kwipiaccount = "1"
LAYERDEPENDS_kwipiaccount = "core microduck"
LAYERSERIES_COMPAT_kwipiaccount = "wrynose"
```

## yocto/meta-kwipi-p15-b12-receiver-selection/conf/layer.conf
```bitbake
BBPATH .= ":${LAYERDIR}"
BBFILES += "${LAYERDIR}/recipes-*/*/*.bbappend"
BBFILE_COLLECTIONS += "kwipib18"
BBFILE_PATTERN_kwipib18 := "^${LAYERDIR}/"
BBFILE_PRIORITY_kwipib18 = "27"
LAYERVERSION_kwipib18 = "1"
LAYERDEPENDS_kwipib18 = "core microduck kwipipy kwipidev kwipipassive kwipiaccount kwipib10 kwipib17"
LAYERSERIES_COMPAT_kwipib18 = "wrynose"
```

## yocto/meta-kwipi-p15-passive-selection/conf/layer.conf
```bitbake
BBPATH .= ":${LAYERDIR}"
BBFILES += "${LAYERDIR}/recipes-*/*/*.bbappend"
BBFILE_COLLECTIONS += "kwipib10"
BBFILE_PATTERN_kwipib10 := "^${LAYERDIR}/"
BBFILE_PRIORITY_kwipib10 = "25"
LAYERVERSION_kwipib10 = "1"
LAYERDEPENDS_kwipib10 = "core microduck kwipipy kwipidev kwipipassive kwipiaccount"
LAYERSERIES_COMPAT_kwipib10 = "wrynose"
```
